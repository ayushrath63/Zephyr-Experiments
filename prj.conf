## CMakeLists.txt
```
# SPDX-License-Identifier: Apache-2.0

cmake_minimum_required(VERSION 3.13.1)
set(NO_BUILD_TYPE_WARNING 1)

set(BOARD_ROOT ${CMAKE_CURRENT_LIST_DIR})
set(BOARD disco_l475_iot1)
find_package(Zephyr REQUIRED HINTS $ENV{ZEPHYR_BASE})
project(blinky)

include(src/serial_pb/serial_pb.cmake)
include_directories(${CMAKE_CURRENT_SOURCE_DIR}/nanopb/)
add_dependencies(app serial_pb)

include_directories(${CMAKE_CURRENT_SOURCE_DIR}/include/)
target_sources(app PRIVATE src/led.c)
target_sources(app PRIVATE src/distance_sensor.c)
target_sources(app PRIVATE src/main.c)
target_sources(app PRIVATE src/imu.c)
```

## prj.conf
```kconfig
CONFIG_CONSOLE=n
CONFIG_STDOUT_CONSOLE=n
CONFIG_UART_CONSOLE=n
CONFIG_SERIAL=y
CONFIG_I2C=y
CONFIG_GPIO=y
CONFIG_SPI=y
CONFIG_SENSOR=y

# VL53L0X Configuration
CONFIG_VL53L0X=y
CONFIG_VL53L0X_PROXIMITY_THRESHOLD=100

# LSM6DSL Configuration
CONFIG_LSM6DSL=y
CONFIG_LSM6DSL_TRIGGER_OWN_THREAD=y
CONFIG_LIS3MDL=y
CONFIG_LSM6DSL_ACCEL_FS=4
CONFIG_LSM6DSL_ACCEL_ODR=5
CONFIG_LSM6DSL_GYRO_FS=1000
CONFIG_LSM6DSL_GYRO_ODR=5
CONFIG_LSM6DSL_THREAD_PRIORITY=2
```

## src/main.c
```c
/*
 * Copyright (c) 2016 Intel Corporation
 *
 * SPDX-License-Identifier: Apache-2.0
 */

#include <zephyr.h>
#include <device.h>
#include <devicetree.h>
#include <drivers/gpio.h>
#include <drivers/uart.h>
#include <drivers/sensor.h>
#include <stdio.h>
#include <sys/printk.h>
#include "led.h"
#include "distance_sensor.h"
#include "imu.h"

#include <pb_decode.h>
#include "serial_pb/simple.pb.h"


/* 1000 msec = 1 sec */
#define SLEEP_TIME_MS   1000
#define STACKSIZE 500
#define LED_PRIORITY 5
#define DIST_SENSOR_PRIORITY 4
#define IMU_PRIORITY 4

K_THREAD_DEFINE(blink0_id, STACKSIZE, blink0, NULL, NULL, NULL,
	LED_PRIORITY, 0, 0);
K_THREAD_DEFINE(blink1_id, STACKSIZE, blink1, NULL, NULL, NULL,
	LED_PRIORITY, 0, 0);
K_THREAD_DEFINE(dist_sensor_sample_id, STACKSIZE, sample_dist_sensor, NULL, NULL, NULL,
	DIST_SENSOR_PRIORITY, 0, 0);

#define UART1_NODE DT_NODELABEL(usart1)
#if DT_NODE_HAS_STATUS(UART1_NODE, okay)
#define UART1	DT_LABEL(UART1_NODE)
#endif
void main(void)
{
	led_init();
	dist_sensor_init();
	imu_init();

	bool proximity_flag;
	double dist_meas;

	double accel_x, accel_y, accel_z;
	double gyro_x, gyro_y, gyro_z;

	SimpleMessage message = SimpleMessage_init_zero;

	/* Fill in the lucky number */
	message.lucky_number = 13;
	message.lucky_number2 = 11;

	const struct device *uart_dev = device_get_binding(UART1);
	uart_poll_out(uart_dev, &message);

	while (1)
	{
		/* vl53l0x proximity & distance */
		proximity_flag = fetch_dist_sensor_prox();
		dist_meas = fetch_dist_sensor_val();
		// printk("vl53l0x:\n");
		// printk("\tproximity_flag = %d\n", proximity_flag);
		// printf("\tdistance = %.3fm\n", dist_meas);

		/* lsm6dsl accel */
		imu_fetch_accelXYZ(&accel_x, &accel_y, &accel_z);
		// printf("lsm6dsl accel:\n\tx: %f ms/2\n\ty: %f ms/2\n\tz: %f ms/2\n",
		// 					  accel_x,
		// 					  accel_y,
		// 					  accel_z);

		/* lsm6dsl gyro */
		imu_fetch_gyroXYZ(&gyro_x, &gyro_y, &gyro_z);
		// printf("lsm6dsl gyro:\n\tx: %f dps\n\ty: %f dps\n\tz: %f dps\n",
		// 					   gyro_x,
		// 					   gyro_y,
		// 					   gyro_z);

		// printk("\n");

		k_msleep(SLEEP_TIME_MS);
	}
}
```

## include/distance_sensor.h
```c
#pragma once

#include <zephyr.h>
#include <device.h>
#include <devicetree.h>
#include <drivers/sensor.h>
#include <stdio.h>
#include <sys/printk.h>

bool dist_sensor_init();

void sample_dist_sensor();
bool fetch_dist_sensor_prox();
double fetch_dist_sensor_val();
```

## include/imu.h
```c
#pragma once

#include <zephyr.h>
#include <device.h>
#include <devicetree.h>
#include <drivers/sensor.h>
#include <stdio.h>
#include <sys/printk.h>

bool imu_init();

double imu_fetch_gyroX();
double imu_fetch_gyroY();
double imu_fetch_gyroZ();
void imu_fetch_gyroXYZ(double *gyroX, double *gyroY, double *gyroZ);

double imu_fetch_accelX();
double imu_fetch_accelY();
double imu_fetch_accelZ();
void imu_fetch_accelXYZ(double *accelX, double *accelY, double *accelZ);
```

## include/led.h
```c
#pragma once

#include <zephyr.h>
#include <device.h>
#include <devicetree.h>
#include <drivers/gpio.h>

/* The devicetree node identifier for the "led0" alias. */
#define LED0_NODE DT_ALIAS(led0)

#if DT_NODE_HAS_STATUS(LED0_NODE, okay)
#define LED0	DT_GPIO_LABEL(LED0_NODE, gpios)
#define PIN0	DT_GPIO_PIN(LED0_NODE, gpios)
#define FLAGS0	DT_GPIO_FLAGS(LED0_NODE, gpios)
#else
/* A build error here means your board isn't set up to blink an LED. */
#error "Unsupported board: led0 devicetree alias is not defined"
#define LED0	""
#define PIN0	0
#define FLAGS0	0
#endif

/* The devicetree node identifier for the "led1" alias. */
#define LED1_NODE DT_ALIAS(led1)

#if DT_NODE_HAS_STATUS(LED1_NODE, okay)
#define LED1	DT_GPIO_LABEL(LED1_NODE, gpios)
#define PIN1	DT_GPIO_PIN(LED1_NODE, gpios)
#define FLAGS1	DT_GPIO_FLAGS(LED1_NODE, gpios)
#else
/* A build error here means your board isn't set up to blink an LED. */
#error "Unsupported board: led1 devicetree alias is not defined"
#define LED1	""
#define PIN1	0
#define FLAGS1	0
#endif

struct led {
	const struct device *gpio_dev;
	gpio_pin_t gpio_pin;
};

bool led_init();

void blink(const struct led *led, uint32_t sleep_ms);
void blink0(void);
void blink1(void);

void toggle0(void);
void toggle1(void);
```

## src/distance_sensor.c
```c
#include "distance_sensor.h"

const struct device *dist_sensor;
struct sensor_value dist_sensor_value;

bool dist_sensor_init()
{

    dist_sensor = device_get_binding(DT_LABEL(DT_INST(0, st_vl53l0x)));
    if (!dist_sensor)
    {
        printk("Could not get VL53L0X device\n");
        return false;
    }
    return true;
}

void sample_dist_sensor()
{
    while(1)
    {
        bool status = sensor_sample_fetch(dist_sensor);
        if(status != 0)
        {
            printk("VL53L0X sample capture failed!\n");
        }
        k_msleep(1);
    }
}

bool fetch_dist_sensor_prox()
{
    bool status = sensor_channel_get(dist_sensor, SENSOR_CHAN_PROX, &dist_sensor_value);
    if (status != 0)
    {
        printk("VL53L0X sample read failed!\n");
    }
    return dist_sensor_value.val1;
}

double fetch_dist_sensor_val()
{
    bool status = sensor_channel_get(dist_sensor, SENSOR_CHAN_DISTANCE, &dist_sensor_value);
    if (status != 0)
    {
        printk("VL53L0X sample read failed!\n");
    }
    return sensor_value_to_double(&dist_sensor_value);
}
```

## src/imu.c
```c
#include "imu.h"

const struct device *lsm6dsl_dev;

static void imu_trigger_handler(struct device *dev, struct sensor_trigger *trig)
{
    bool status = true;
    status &= sensor_sample_fetch_chan(dev, SENSOR_CHAN_ACCEL_XYZ);
    status &= sensor_sample_fetch_chan(dev, SENSOR_CHAN_GYRO_XYZ);
    if(status != 0)
    {
        printk("LSM6DSL sample capture failed!\n");
    }

    return;
}

bool imu_init()
{
	lsm6dsl_dev = device_get_binding(DT_LABEL(DT_INST(0, st_lsm6dsl)));

	if (lsm6dsl_dev == NULL) {
		printk("Could not get LSM6DSL device\n");
		return false;
	}

    struct sensor_trigger trig = 
    {
        .type = SENSOR_TRIG_DATA_READY,
        .chan = SENSOR_CHAN_ACCEL_XYZ
    };

    if (sensor_trigger_set(lsm6dsl_dev, &trig, (sensor_trigger_handler_t)imu_trigger_handler) != 0) {
		printk("Could not set sensor type and channel\n");
		return false;
	}

    return true;
}

inline double imu_fetch_gyroX()
{
    static struct sensor_value gyro_x;
    bool status = sensor_channel_get(lsm6dsl_dev, SENSOR_CHAN_GYRO_X, &gyro_x);
    if(status != 0)
    {
        printk("LSM6DSL Gyro X sample read failed!\n");
    }
    return sensor_value_to_double(&gyro_x);
}

inline double imu_fetch_gyroY()
{
    static struct sensor_value gyro_y;
    bool status = sensor_channel_get(lsm6dsl_dev, SENSOR_CHAN_GYRO_Y, &gyro_y);
    if(status != 0)
    {
        printk("LSM6DSL Gyro Y sample read failed!\n");
    }
    return sensor_value_to_double(&gyro_y);
}

inline double imu_fetch_gyroZ()
{
    static struct sensor_value gyro_z;
    bool status = sensor_channel_get(lsm6dsl_dev, SENSOR_CHAN_GYRO_Z, &gyro_z);
    if(status != 0)
    {
        printk("LSM6DSL Gyro Z sample read failed!\n");
    }
    return sensor_value_to_double(&gyro_z);
}

void imu_fetch_gyroXYZ(double *gyroX, double *gyroY, double *gyroZ)
{
    *gyroX = imu_fetch_gyroX();
    *gyroY = imu_fetch_gyroY();
    *gyroZ = imu_fetch_gyroZ();
}

double imu_fetch_accelX()
{
    static struct sensor_value accel_x;
    bool status = sensor_channel_get(lsm6dsl_dev, SENSOR_CHAN_ACCEL_X, &accel_x);
    if(status != 0)
    {
        printk("LSM6DSL Accel X sample read failed!\n");
    }
    return sensor_value_to_double(&accel_x);
}

double imu_fetch_accelY()
{
    static struct sensor_value accel_y;
    bool status = sensor_channel_get(lsm6dsl_dev, SENSOR_CHAN_ACCEL_Y, &accel_y);
    if(status != 0)
    {
        printk("LSM6DSL Accel Y sample read failed!\n");
    }
    return sensor_value_to_double(&accel_y);
}

double imu_fetch_accelZ()
{
    static struct sensor_value accel_z;
    bool status = sensor_channel_get(lsm6dsl_dev, SENSOR_CHAN_ACCEL_Z, &accel_z);
    if(status != 0)
    {
        printk("LSM6DSL Accel Z sample read failed!\n");
    }
    return sensor_value_to_double(&accel_z);
}

void imu_fetch_accelXYZ(double *accelX, double *accelY, double *accelZ)
{
    *accelX = imu_fetch_accelX();
    *accelY = imu_fetch_accelY();
    *accelZ = imu_fetch_accelZ();
}
```

## src/led.c
```c
#include "led.h"

struct led led_data[2];

bool led_init()
{
	led_data[0].gpio_dev = device_get_binding(LED0);
	if (led_data[0].gpio_dev == NULL) {
		printk("Could not get led0 device\n");
		return false;
	}
	
	led_data[1].gpio_dev = device_get_binding(LED1);
	if (led_data[1].gpio_dev == NULL) {
		printk("Could not get led1 device\n");
		return false;
	}

	if(gpio_pin_configure(led_data[0].gpio_dev, PIN0, GPIO_OUTPUT_ACTIVE | FLAGS0) < 0)
		return false;
	if(gpio_pin_configure(led_data[1].gpio_dev, PIN1, GPIO_OUTPUT_ACTIVE | FLAGS1) < 0)
		return false;
	
	led_data[0].gpio_pin = PIN0;
	led_data[1].gpio_pin = PIN1;

	return true;
}

void blink(const struct led *led, uint32_t sleep_ms)
{
	while (1) {
		gpio_pin_toggle(led->gpio_dev, led->gpio_pin);
		k_msleep(sleep_ms);
	}
}

void blink0(void)
{
	blink(&led_data[0], 500);
}

void blink1(void)
{
	blink(&led_data[1], 1000);
}

void toggle0(void)
{
    gpio_pin_toggle(led_data[0].gpio_dev, led_data[0].gpio_pin);
}
void toggle1(void)
{
    gpio_pin_toggle(led_data[1].gpio_dev, led_data[1].gpio_pin);
}
```
